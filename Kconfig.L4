## Kconfig.L4
```kconfig
menu "I2C driver"

config I2C_DRIVER_RPI4
	bool "RPI4"
	default y
	help
	  Include support for the Raspberry Pi 4 I2C controller.

config I2C_DRIVER_IMX21
	bool "i.MX I2C (imx21 compatible)"
	default y
	help
	  Include support for the i.MX I2C controller (fsl,imx21-i2c and
	  fsl,imx8mp-i2c), as found on the i.MX 8M family.

endmenu
```
